## meta/conf/machine/yosemite.conf
```bitbake
#@Name: AMCC Yosemite Platform


TARGET_ARCH = "powerpc"

PREFERRED_PROVIDER_virtual/kernel = "linux"
KERNEL_IMAGETYPE = "uImage"

MACHINE_FEATURES = "kernel26 usbhost"

#PREFERRED_VERSION_u-boot = "1.3.2"
#UBOOT_MACHINE = "sequoia_config"
#UBOOT_ENTRYPOINT = "0"
#UBOOT_LOADADDRESS = "0"



#don't try to access tty1
USE_VT = "0"
SERIAL_CONSOLE = "115200 ttyS0"

EXTRA_IMAGECMD = "--big-endian"
IMAGE_FSTYPES = "tar.gz"

#tune for the AMCC440 cpu
require conf/machine/include/tune-ppc476.inc
```
